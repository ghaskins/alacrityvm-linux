## drivers/infiniband/hw/vbib/Kconfig
```kconfig
config INFINIBAND_VBUS
	tristate "Virtual-bus Infiniband HCA support"
	depends on VBUS_PROXY
	---help---
	  This is a low-level driver for a virtual Infiniband HCA
	  device on a virtual-bus.
```

## kernel/vbus/Kconfig
```kconfig
#
# Virtual-Bus (VBus) configuration
#

config VBUS
       bool "Virtual-Bus Containers"
       select CONFIGFS_FS
       select SHM_SIGNAL
       default n
       help
        Provides a mechansism for declaring virtual resource containers
	and virtual-devices within those containers.  These devices may
	then be accessed by any context that cohabitates the same
	container, providing direct host-kernel access in a controlled
	manner.

	If you plan on using this kernel as a VBUS backend, say Y.  If
	unsure, say N

menuconfig VBUS_CONNECTORS
       bool "Virtual-Bus Connectors"
       depends on VBUS
       default n
       help
        Connectors bridge a vbus container to an environment, such
	as a hypervisor or userspace.

	If you plan on using this kernel as a VBUS backend, say Y.  If
	unsure, say N

source "kernel/vbus/connectors/Kconfig"
```

## kernel/vbus/connectors/Kconfig
```kconfig
config VBUS_LOCALHOST
       tristate "Virtual-Bus localhost connector"
       depends on VBUS_CONNECTORS
       default n
       help
         Provides a example connector that bridges vbus devices to
	 the same local kernel.

	 If unsure, say N

config VBUS_KVM
       tristate "Virtual-Bus connector for KVM"
       depends on VBUS
       depends on KVM
       default y
       help
         Provides a connector for allowing KVM guests to access
	 virtual-bus objects.

	 If unsure, say N
```

## kernel/vbus/devices/Kconfig
```kconfig
source "kernel/vbus/devices/venet/Kconfig"
source "kernel/vbus/devices/ibswitch/Kconfig"
```

## kernel/vbus/devices/ibswitch/Kconfig
```kconfig
config VBUS_IBSWITCH
       tristate "Virtual-Bus Infiniband Switch"
       depends on VBUS_DEVICES
       default n
       help
        Provides a virtual Infiniband switch for intra-host routing
	of IB packets from VBIB HCA devices

	If unsure, say N
```

## kernel/vbus/devices/venet/Kconfig
```kconfig
#
# Virtual-Bus (VBus) configuration
#

config VBUS_VENETTAP
       tristate "Virtual-Bus Ethernet Tap Device"
       depends on VBUS_DEVICES
       default n
       help
        Provides a virtual ethernet adapter to a vbus, which in turn
        manifests itself as a standard netif based adapter to the
	kernel.  It can be used similarly to a "tuntap" device,
        except that the char-dev transport is replaced with a vbus/ioq
        interface.

	If unsure, say N
```
